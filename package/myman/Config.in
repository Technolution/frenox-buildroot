## package/myman/Config.in
```kconfig
config BR2_PACKAGE_MYMAN
    bool "myman"
    help
        MyMan console pacman clone

        https://myman.sourceforge.io/
```

## package/openvpn-nl/Config.in
```kconfig
config BR2_PACKAGE_OPENVPN_NL
	bool "openvpn-nl"
	depends on BR2_USE_MMU # fork()
	select BR2_PACKAGE_POLARSSL_NL
	help
	  OpenVPN-NL is a full-featured SSL VPN solution which can
	  accomodate a wide range of configurations, including road
	  warrior access, home/office/campus telecommuting, WiFi
	  security, secure branch office linking, and enterprise-scale
	  remote access solutions with load balancing, failover, and
	  fine-grained access-controls.

	  https://openvpn.fox-it.com/repos/source/2.3.9-nl2/

#if BR2_PACKAGE_OPENVPN_NL
#
#config BR2_PACKAGE_OPENVPN_LZO
#	bool "LZO compression"
#	default y
#	select BR2_PACKAGE_LZO
#	help
#	  Enable LZO compression.
#
#config BR2_PACKAGE_OPENVPN_SMALL
#	bool "Optimize for small size"
#	help
#	  Make OpenVPN as small as possible.
#	  You loose eurephia, debugging info, help messages and more.
#	  It saves around 100 KiB in binary file size.
#
#config BR2_PACKAGE_OPENVPN_PWSAVE
#	bool "Allow passwords in files"
#	help
#	  Allow --askpass and --auth-user-pass passwords to be read
#	  from a file.
#
#endif
```

## package/pkcs11-helper-nl/Config.in
```kconfig
config BR2_PACKAGE_PKCS11_HELPER_NL
	bool "pkcs11-helper-nl"
	help
	  Copied from Fox-It
```
